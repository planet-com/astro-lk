;DDRPHY0AO=0x10238000

;DRAMC brocast on
D.S SD:0x100010B4 %LE %LONG 0x0000007f;
;EMI setting 1
D.S SD:0x10219000 %LE %LONG 0xA053A054;  ;1ch
;D.S SD:0x10219000 %LE %LONG 0xA053A154; ;2ch
D.S SD:0x10219020 %LE %LONG 0x00000000;
D.S SD:0x10219038 %LE %LONG 0x00000030;
D.S SD:0x1021903C %LE %LONG 0x00000010;
D.S SD:0x10235000 %LE %LONG 0x0400A051;
D.S SD:0x1023515C %LE %LONG 0x82410222;
D.S SD:0x10235048 %LE %LONG 0x00020027;
D.S SD:0x102190E8 %LE %LONG 0x00000020;

;DRAMC brocast off
D.S SD:0x100010B4 %LE %LONG 0x00000000;


	; sram_init_by_dramc_shu0_99() ;

D.S SD:0x100010b4 %LE %LONG 0x00000000;
D.S SD:0x10248618 %LE %LONG 0x00f3100a;
D.S SD:0x10238618 %LE %LONG 0x00f3100a;
D.S SD:0x10248618 %LE %LONG 0x00f3100b;
D.S SD:0x10238618 %LE %LONG 0x00f3100b;
D.S SD:0x10248618 %LE %LONG 0x00f3100a;
D.S SD:0x10238618 %LE %LONG 0x00f3100a;
D.S SD:0x10248618 %LE %LONG 0x00f3101a;
D.S SD:0x10238618 %LE %LONG 0x00f3101a;
D.S SD:0x10248618 %LE %LONG 0x00f3101b;
D.S SD:0x10238618 %LE %LONG 0x00f3101b;
D.S SD:0x10248618 %LE %LONG 0x00f3101a;
D.S SD:0x10238618 %LE %LONG 0x00f3101a;
D.S SD:0x10248618 %LE %LONG 0x00f31018;
D.S SD:0x10238618 %LE %LONG 0x00f31018;
D.S SD:0x100010b4 %LE %LONG 0x0000007f;
D.S SD:0x10238618 %LE %LONG 0x20f31018;

	;	init_golden_mini_dpy_init_flow_vseq() ;
		D.S SD:0x102384a0 %LE %LONG 0x00180101;
    D.S SD:0x10238640 %LE %LONG 0x01001080;
    D.S SD:0x10238640 %LE %LONG 0x81001080;
    D.S SD:0x102384a0 %LE %LONG 0x00080101;
    D.S SD:0x10238534 %LE %LONG 0x00000000;
    D.S SD:0x10238160 %LE %LONG 0x00000000;
    D.S SD:0x102382e0 %LE %LONG 0x00000000;
    D.S SD:0x10238460 %LE %LONG 0x00000000;
    D.S SD:0x10238534 %LE %LONG 0x000007fa;
    D.S SD:0x10238160 %LE %LONG 0x1ffe2310;
    D.S SD:0x102382e0 %LE %LONG 0x1ffe2310;
    D.S SD:0x10238460 %LE %LONG 0x1ffea310;
    D.S SD:0x10238534 %LE %LONG 0x000007fa;
    D.S SD:0x10238160 %LE %LONG 0x1ffe2310;
    D.S SD:0x102382e0 %LE %LONG 0x1ffe2310;
    D.S SD:0x10238460 %LE %LONG 0x1ffea310;
    D.S SD:0x10238534 %LE %LONG 0x000007fa;
    D.S SD:0x10238508 %LE %LONG 0x000bbb10;
    D.S SD:0x10238460 %LE %LONG 0x1ffeb310;
    D.S SD:0x10248460 %LE %LONG 0x1ffea310;
    D.S SD:0x102384fc %LE %LONG 0x333f3f00;
    D.S SD:0x1023847c %LE %LONG 0x00000000;
    D.S SD:0x1023848c %LE %LONG 0x00214040;
    D.S SD:0x10238bb8 %LE %LONG 0x00c00020;
    D.S SD:0x10238b98 %LE %LONG 0x0000020c;
    D.S SD:0x10238b80 %LE %LONG 0x00020000;
    D.S SD:0x1023817c %LE %LONG 0x00000000;
    D.S SD:0x1023818c %LE %LONG 0x00244040;
    D.S SD:0x102388b8 %LE %LONG 0x00000020;
    D.S SD:0x10238898 %LE %LONG 0x0000020c;
    D.S SD:0x10238880 %LE %LONG 0x00020000;
    D.S SD:0x102382fc %LE %LONG 0x00000000;
    D.S SD:0x1023830c %LE %LONG 0x00244040;
    D.S SD:0x10238a38 %LE %LONG 0x00000020;
    D.S SD:0x10238a18 %LE %LONG 0x0000020c;
    D.S SD:0x10238a00 %LE %LONG 0x00020000;
    D.S SD:0x1023848c %LE %LONG 0x00200000;
    D.S SD:0x10238b6c %LE %LONG 0x00000000;
    D.S SD:0x10238188 %LE %LONG 0x00010e00;
    D.S SD:0x1023818c %LE %LONG 0x00210040;
    D.S SD:0x10238180 %LE %LONG 0x00000402;
    D.S SD:0x1023818c %LE %LONG 0x00211040;
    D.S SD:0x10238308 %LE %LONG 0x00010e00;
    D.S SD:0x1023830c %LE %LONG 0x00210040;
    D.S SD:0x10238300 %LE %LONG 0x00000402;
    D.S SD:0x1023830c %LE %LONG 0x00211040;
    D.S SD:0x10238b9c %LE %LONG 0x6cd2960f;
    D.S SD:0x10238494 %LE %LONG 0x00012000;
    D.S SD:0x1023889c %LE %LONG 0xe60d6fdd;
    D.S SD:0x10238194 %LE %LONG 0x00002000;
    D.S SD:0x10238a1c %LE %LONG 0x40234c4b;
    D.S SD:0x10238314 %LE %LONG 0x00002000;
    D.S SD:0x1023886c %LE %LONG 0x0000000e;
    D.S SD:0x102389ec %LE %LONG 0x0000000e;
    D.S SD:0x10238b6c %LE %LONG 0x00000000;
    D.S SD:0x10238540 %LE %LONG 0x00000008;
    D.S SD:0x10238188 %LE %LONG 0x01031000;
    D.S SD:0x1023818c %LE %LONG 0x10211040;
    D.S SD:0x10238308 %LE %LONG 0x01031000;
    D.S SD:0x1023830c %LE %LONG 0x10211040;
    D.S SD:0x10238480 %LE %LONG 0x0000000c;
    D.S SD:0x10238498 %LE %LONG 0x00000051;
    D.S SD:0x10238180 %LE %LONG 0x0000040e;
    D.S SD:0x10238198 %LE %LONG 0x00000051;
    D.S SD:0x10238300 %LE %LONG 0x0000040e;
    D.S SD:0x10238318 %LE %LONG 0x00000051;
    D.S SD:0x10238b84 %LE %LONG 0x000a0000;
    D.S SD:0x10238744 %LE %LONG 0x00000011;
    D.S SD:0x10238000 %LE %LONG 0x00000000;
    D.S SD:0x10238004 %LE %LONG 0x00000010;
    D.S SD:0x10238704 %LE %LONG 0x5b000002;
    D.S SD:0x10238724 %LE %LONG 0x5b000002;
    D.S SD:0x10238708 %LE %LONG 0x00040000;
    D.S SD:0x10238728 %LE %LONG 0x00040000;
    D.S SD:0x10238700 %LE %LONG 0xe57800fe;
    D.S SD:0x10238720 %LE %LONG 0xe57800fe;
    D.S SD:0x1023870c %LE %LONG 0x00001263;
    D.S SD:0x10238008 %LE %LONG 0x00010000;
    D.S SD:0x10238000 %LE %LONG 0x80000000;
    D.S SD:0x10238740 %LE %LONG 0x00009745;
    D.S SD:0x10238d98 %LE %LONG 0x00000002;
    D.S SD:0x10238ba4 %LE %LONG 0x00020400;
    D.S SD:0x102388a4 %LE %LONG 0x00020400;
    D.S SD:0x10238a24 %LE %LONG 0x00020400;
    D.S SD:0x100010b4 %LE %LONG 0x00000000;
    D.S SD:0x10238b74 %LE %LONG 0x00c00604;
    D.S SD:0x10248b74 %LE %LONG 0x00c00604;
    D.S SD:0x100010b4 %LE %LONG 0x0000007f;
    D.S SD:0x10238874 %LE %LONG 0x00c00604;
    D.S SD:0x102389f4 %LE %LONG 0x00c00604;
    D.S SD:0x1023846c %LE %LONG 0x00000008;
    D.S SD:0x10238494 %LE %LONG 0x0001a000;
    D.S SD:0x1023816c %LE %LONG 0x00000008;
    D.S SD:0x10238194 %LE %LONG 0x0000a000;
    D.S SD:0x102382ec %LE %LONG 0x00000008;
    D.S SD:0x10238314 %LE %LONG 0x0000a000;
    D.S SD:0x10238008 %LE %LONG 0x00610000;
    D.S SD:0x10238470 %LE %LONG 0x00200000;
    D.S SD:0x10238ba4 %LE %LONG 0x00000800;
    D.S SD:0x102388a4 %LE %LONG 0x00000000;
    D.S SD:0x10238a24 %LE %LONG 0x00000000;
    D.S SD:0x10238ba8 %LE %LONG 0x000ba000;
    D.S SD:0x102388a8 %LE %LONG 0x000ae800;
    D.S SD:0x10238a28 %LE %LONG 0x000ae800;
    D.S SD:0x100010b4 %LE %LONG 0x00000000;
    D.S SD:0x10238478 %LE %LONG 0x60000000;
    D.S SD:0x10238178 %LE %LONG 0x70000000;
    D.S SD:0x102382f8 %LE %LONG 0x70000000;
    D.S SD:0x10248478 %LE %LONG 0x70000000;
    D.S SD:0x10248178 %LE %LONG 0x70000000;
    D.S SD:0x102482f8 %LE %LONG 0x70000000;
    D.S SD:0x10238b94 %LE %LONG 0x00707000;
    D.S SD:0x10248b94 %LE %LONG 0x00707000;
    D.S SD:0x10238b98 %LE %LONG 0x00007a1c;
    D.S SD:0x10248b98 %LE %LONG 0x00007a1c;
    D.S SD:0x10238b78 %LE %LONG 0x00001071;
    D.S SD:0x10248b78 %LE %LONG 0x00001071;
    D.S SD:0x10238b98 %LE %LONG 0x00007e1c;
    D.S SD:0x10248b98 %LE %LONG 0x00007e1c;
    D.S SD:0x10238b94 %LE %LONG 0x04707000;
    D.S SD:0x10248b94 %LE %LONG 0x04707000;
    D.S SD:0x100010b4 %LE %LONG 0x0000007f;
    D.S SD:0x10238894 %LE %LONG 0x04707000;
    D.S SD:0x10238898 %LE %LONG 0x00007e1c;
    D.S SD:0x10238878 %LE %LONG 0x00001071;
    D.S SD:0x10238a14 %LE %LONG 0x04707000;
    D.S SD:0x10238a18 %LE %LONG 0x00007e1c;
    D.S SD:0x102389f8 %LE %LONG 0x00001071;
    D.S SD:0x100010b4 %LE %LONG 0x00000000;
    D.S SD:0x10238b8c %LE %LONG 0x1a214009;
    D.S SD:0x10248b8c %LE %LONG 0x4d5f071c;
    D.S SD:0x100010b4 %LE %LONG 0x0000007f;
    D.S SD:0x1023888c %LE %LONG 0xf4f4e5fd;
    D.S SD:0x10238a0c %LE %LONG 0x9a17ae3c;
    D.S SD:0x1023851c %LE %LONG 0x00050003;
    D.S SD:0x102384ec %LE %LONG 0x00000111;
    D.S SD:0x102384ec %LE %LONG 0x00000110;
    D.S SD:0x102384ec %LE %LONG 0x20000110;
    D.S SD:0x100010b4 %LE %LONG 0x00000000;
    D.S SD:0x10238b98 %LE %LONG 0x00017e1c;
    D.S SD:0x10248b98 %LE %LONG 0x00017e1c;
    D.S SD:0x100010b4 %LE %LONG 0x0000007f;
    D.S SD:0x10238898 %LE %LONG 0x00017e1c;
    D.S SD:0x10238a18 %LE %LONG 0x00017e1c;

; init_golden_mini_freq_related_vseq_0() ;
    D.S SD:0x10238d48 %LE %LONG 0x0e93a4e9;
    D.S SD:0x10238d4c %LE %LONG 0x8e93a4e9;
    D.S SD:0x10238d50 %LE %LONG 0x14a5294a;
    D.S SD:0x10238d54 %LE %LONG 0x14a5294a;
    D.S SD:0x10238d5c %LE %LONG 0x00000007;
    D.S SD:0x10238d44 %LE %LONG 0x80380002;
    D.S SD:0x10238d7c %LE %LONG 0x010ff048;
    D.S SD:0x10238d38 %LE %LONG 0x00070707; ; hj datlat ; 0x00080808 -> 0x00070707
    D.S SD:0x10238d24 %LE %LONG 0x00108500;
    D.S SD:0x10238d20 %LE %LONG 0x20020010;
    D.S SD:0x10238d8c %LE %LONG 0x00000222;
    D.S SD:0x10238be0 %LE %LONG 0x00000002;
    D.S SD:0x10238c60 %LE %LONG 0x00000002;
    D.S SD:0x102387a0 %LE %LONG 0x000000d9; ; hj gating : fb -> d9
    D.S SD:0x102387a4 %LE %LONG 0x00000019;
    D.S SD:0x10238820 %LE %LONG 0x000000d9; ; hj gating : fb -> d9
    D.S SD:0x10238824 %LE %LONG 0x00000019;
    D.S SD:0x10238920 %LE %LONG 0x000000d9; ; hj gating : fb -> d9
    D.S SD:0x10238924 %LE %LONG 0x00000019;
    D.S SD:0x102389a0 %LE %LONG 0x000000d9; ; hj gating : fb -> d9
    D.S SD:0x102389a4 %LE %LONG 0x00000019;
    D.S SD:0x10238d28 %LE %LONG 0xe0000011;
    D.S SD:0x10238884 %LE %LONG 0x13008000;
    D.S SD:0x10238a04 %LE %LONG 0x13008000;
    D.S SD:0x10238d6c %LE %LONG 0x00000001;
    D.S SD:0x102387a8 %LE %LONG 0x00000055;
    D.S SD:0x10238828 %LE %LONG 0x00000055;
    D.S SD:0x10238928 %LE %LONG 0x00000055;
    D.S SD:0x102389a8 %LE %LONG 0x00000055;
    D.S SD:0x1023168c %LE %LONG 0x00000030;
    D.S SD:0x10238d78 %LE %LONG 0x01000391;
    D.S SD:0x10238be8 %LE %LONG 0x0000bfe0;
    D.S SD:0x10238c68 %LE %LONG 0x0000bfe0;
    D.S SD:0x10238798 %LE %LONG 0x00000b19;
    D.S SD:0x10238918 %LE %LONG 0x00000b19;
    D.S SD:0x10238818 %LE %LONG 0x00000b19;
    D.S SD:0x10238998 %LE %LONG 0x00000b19;
    D.S SD:0x1023879c %LE %LONG 0x0f000b19;
    D.S SD:0x1023891c %LE %LONG 0x0f000b19;
    D.S SD:0x1023881c %LE %LONG 0x0f000b19;
    D.S SD:0x1023899c %LE %LONG 0x0f000b19;
    D.S SD:0x10238794 %LE %LONG 0x00191900;
    D.S SD:0x10238914 %LE %LONG 0x001b1b00;
    D.S SD:0x10238814 %LE %LONG 0x00171700;
    D.S SD:0x10238994 %LE %LONG 0x00181800;
    D.S SD:0x10231610 %LE %LONG 0x80005080;
    D.S SD:0x102316ac %LE %LONG 0x80000018;
    D.S SD:0x10231230 %LE %LONG 0x00000001;
    D.S SD:0x10231430 %LE %LONG 0x00000001;
    D.S SD:0x102316a8 %LE %LONG 0x00000000;
    D.S SD:0x1023167c %LE %LONG 0x11111122;
    D.S SD:0x10231680 %LE %LONG 0x11661111;
    D.S SD:0x10231200 %LE %LONG 0x11111122;
    D.S SD:0x10231204 %LE %LONG 0x11111122;
    D.S SD:0x10231208 %LE %LONG 0x11771122; ; hj, from 0x11661111 to 0x11771122
    D.S SD:0x1023120c %LE %LONG 0x11771122; ; hj, from 0x11661111 to 0x11771122
    D.S SD:0x10231400 %LE %LONG 0x11111122;
    D.S SD:0x10231404 %LE %LONG 0x11111122;
    D.S SD:0x10231408 %LE %LONG 0x11771122; ; hj, from 0x11661111 to 0x11771122
    D.S SD:0x1023140c %LE %LONG 0x11771122; ; hj, from 0x11661111 to 0x11771122
    D.S SD:0x10231210 %LE %LONG 0x001b0019;
    D.S SD:0x10231214 %LE %LONG 0x001b0019;
    D.S SD:0x10231220 %LE %LONG 0x001b0019;
    D.S SD:0x10231410 %LE %LONG 0x00180017;
    D.S SD:0x10231414 %LE %LONG 0x00180017;
    D.S SD:0x10231420 %LE %LONG 0x00180017;
    D.S SD:0x10231224 %LE %LONG 0x191b191b;
    D.S SD:0x10231424 %LE %LONG 0x17181718;
    D.S SD:0x10238760 %LE %LONG 0x1c1c1c1c;
    D.S SD:0x10238764 %LE %LONG 0x1c1c1c1c;
    D.S SD:0x1023876c %LE %LONG 0x0000001c;
    D.S SD:0x102388e0 %LE %LONG 0x04040404;
    D.S SD:0x102388e4 %LE %LONG 0x04040404;
    D.S SD:0x102388ec %LE %LONG 0x00000004;
    D.S SD:0x102387e0 %LE %LONG 0x38383838;
    D.S SD:0x102387e4 %LE %LONG 0x38383838;
    D.S SD:0x102387ec %LE %LONG 0x00000038;
    D.S SD:0x10238960 %LE %LONG 0x2c2c2c2c;
    D.S SD:0x10238964 %LE %LONG 0x2c2c2c2c;
    D.S SD:0x1023896c %LE %LONG 0x0000002c;
    D.S SD:0x1023888c %LE %LONG 0xf4f0e5fd;
    D.S SD:0x10238a0c %LE %LONG 0x9a11ae3c;
    D.S SD:0x10231618 %LE %LONG 0x00000000;
    D.S SD:0x1023161c %LE %LONG 0x00010000;
    D.S SD:0x10231620 %LE %LONG 0x00000000;
    D.S SD:0x10231624 %LE %LONG 0x00000000;
    D.S SD:0x10231628 %LE %LONG 0x11111011;
    D.S SD:0x10231608 %LE %LONG 0x30000030;
    D.S SD:0x10231614 %LE %LONG 0x00002600;
    D.S SD:0x10231664 %LE %LONG 0x16a704a7;
    D.S SD:0x10231660 %LE %LONG 0x04040303;
    D.S SD:0x10231644 %LE %LONG 0xb3010744;
    D.S SD:0x10231648 %LE %LONG 0x00000132;
    D.S SD:0x1023164c %LE %LONG 0x000410a0;
    D.S SD:0x10231650 %LE %LONG 0x00004409;
    D.S SD:0x10231654 %LE %LONG 0x0c05442b;
    D.S SD:0x10231658 %LE %LONG 0x000e0808;
    D.S SD:0x1023165c %LE %LONG 0x28302205;
    D.S SD:0x10231678 %LE %LONG 0x03111001;
    D.S SD:0x102316a4 %LE %LONG 0x00070002;
    D.S SD:0x10238888 %LE %LONG 0x0020004a;
    D.S SD:0x10238a08 %LE %LONG 0x0020004a;
    D.S SD:0x1023886c %LE %LONG 0x0060000e;
    D.S SD:0x102389ec %LE %LONG 0x0060000e;
    D.S SD:0x10238774 %LE %LONG 0x10101010;
    D.S SD:0x10238778 %LE %LONG 0x10101010;
    D.S SD:0x1023877c %LE %LONG 0x10101010;
    D.S SD:0x10238780 %LE %LONG 0x10101010;
    D.S SD:0x10238784 %LE %LONG 0x00001010;
    D.S SD:0x10238788 %LE %LONG 0x00a500a5;
    D.S SD:0x102387f4 %LE %LONG 0x0f0f0f0f;
    D.S SD:0x102387f8 %LE %LONG 0x0f0f0f0f;
    D.S SD:0x102387fc %LE %LONG 0x0f0f0f0f;
    D.S SD:0x10238800 %LE %LONG 0x0f0f0f0f;
    D.S SD:0x10238804 %LE %LONG 0x00000f0f;
    D.S SD:0x10238808 %LE %LONG 0x00a400a4;
    D.S SD:0x102388f4 %LE %LONG 0x10101010;
    D.S SD:0x102388f8 %LE %LONG 0x10101010;
    D.S SD:0x102388fc %LE %LONG 0x10101010;
    D.S SD:0x10238900 %LE %LONG 0x10101010;
    D.S SD:0x10238904 %LE %LONG 0x00001010;
    D.S SD:0x10238908 %LE %LONG 0x00a500a5;
    D.S SD:0x10238974 %LE %LONG 0x0f0f0f0f;
    D.S SD:0x10238978 %LE %LONG 0x0f0f0f0f;
    D.S SD:0x1023897c %LE %LONG 0x0f0f0f0f;
    D.S SD:0x10238980 %LE %LONG 0x0f0f0f0f;
    D.S SD:0x10238984 %LE %LONG 0x00000f0f;
    D.S SD:0x10238988 %LE %LONG 0x00a400a4;
    D.S SD:0x10238198 %LE %LONG 0x00000050;
    D.S SD:0x10238318 %LE %LONG 0x00000050;
    D.S SD:0x10238198 %LE %LONG 0x00000051;
    D.S SD:0x10238318 %LE %LONG 0x00000051;
    D.S SD:0x10238184 %LE %LONG 0x10101c1c;
    D.S SD:0x10238304 %LE %LONG 0x10101c1c;
    D.S SD:0x10238188 %LE %LONG 0x03031000;
    D.S SD:0x10238308 %LE %LONG 0x03031000;
    D.S SD:0x10231604 %LE %LONG 0x00001411;
    D.S SD:0x10231674 %LE %LONG 0x80000026;
    D.S SD:0x10231610 %LE %LONG 0xa0005080;
    D.S SD:0x102316a0 %LE %LONG 0x000811bf;
    D.S SD:0x10231600 %LE %LONG 0x00000012;
    D.S SD:0x1023160c %LE %LONG 0x00000004;
    D.S SD:0x10230238 %LE %LONG 0x00400010;
    D.S SD:0x10231688 %LE %LONG 0x0e13020b;
    D.S SD:0x10238d18 %LE %LONG 0x00009800;
    D.S SD:0x10238d14 %LE %LONG 0x00004310;
    D.S SD:0x10238d2c %LE %LONG 0x00080419;
    D.S SD:0x10238d88 %LE %LONG 0x00000052;
    D.S SD:0x1023163c %LE %LONG 0x0008000d;
    D.S SD:0x10231640 %LE %LONG 0x0000000d;
    D.S SD:0x102316b0 %LE %LONG 0x20202020;
    D.S SD:0x10238d1c %LE %LONG 0x005a05a1;
    D.S SD:0x100010b4 %LE %LONG 0x00000000;
    D.S SD:0x100010b4 %LE %LONG 0x0000007f;
    D.S SD:0x10231694 %LE %LONG 0xffff0006;
    D.S SD:0x10231690 %LE %LONG 0x00040111;
    D.S SD:0x10231228 %LE %LONG 0x0b060b06;
    D.S SD:0x10231428 %LE %LONG 0x0b060b06;
    D.S SD:0x1023122c %LE %LONG 0x00c50128;
    D.S SD:0x1023142c %LE %LONG 0x00c50128;
    D.S SD:0x10231688 %LE %LONG 0x0613020b;
    D.S SD:0x1023169c %LE %LONG 0xf8000000;
    D.S SD:0x1023169c %LE %LONG 0xf8000005;
    D.S SD:0x10231614 %LE %LONG 0x00052600;
    D.S SD:0x10238888 %LE %LONG 0x0020804a;
    D.S SD:0x10238a08 %LE %LONG 0x0020804a;
    D.S SD:0x10238884 %LE %LONG 0x13008900;
    D.S SD:0x10238a04 %LE %LONG 0x13008900;
    D.S SD:0x10238880 %LE %LONG 0x00020080;
    D.S SD:0x10238a00 %LE %LONG 0x00020080;

;	init_golden_mini_common_settings_vseq() ;
    D.S SD:0x102384f4 %LE %LONG 0x006003bf;
    D.S SD:0x102384f4 %LE %LONG 0x006003be;
    D.S SD:0x102384f4 %LE %LONG 0x006003bf;
    D.S SD:0x102384f4 %LE %LONG 0x006003be;
    D.S SD:0x102384f4 %LE %LONG 0x006003af;
    D.S SD:0x1023863c %LE %LONG 0xb8000003;
    D.S SD:0x10238664 %LE %LONG 0x00000101;
    D.S SD:0x10238630 %LE %LONG 0x01000000;
    D.S SD:0x10238498 %LE %LONG 0x00000051;
    D.S SD:0x10238198 %LE %LONG 0x000004d1;
    D.S SD:0x10238318 %LE %LONG 0x000004d1;
    D.S SD:0x10238664 %LE %LONG 0x00000101;
    D.S SD:0x10238640 %LE %LONG 0x81001080;
    D.S SD:0x102388b4 %LE %LONG 0x00000004;
    D.S SD:0x10238878 %LE %LONG 0x00031071;
    D.S SD:0x10238a34 %LE %LONG 0x00000004;
    D.S SD:0x102389f8 %LE %LONG 0x00031071;
    D.S SD:0x10238bb4 %LE %LONG 0x00000000;
    D.S SD:0x10238b78 %LE %LONG 0x00001071;
    D.S SD:0x10238170 %LE %LONG 0x00000000;
    D.S SD:0x102382f0 %LE %LONG 0x00000000;
    D.S SD:0x10238470 %LE %LONG 0x00200000;
    D.S SD:0x10238618 %LE %LONG 0x20f05018;
    D.S SD:0x102384fc %LE %LONG 0x11400000;
    D.S SD:0x10238498 %LE %LONG 0x00000051;
    D.S SD:0x10238198 %LE %LONG 0x000000d1;
    D.S SD:0x10238318 %LE %LONG 0x000000d1;
    D.S SD:0x10238880 %LE %LONG 0x00020083;
    D.S SD:0x1023887c %LE %LONG 0x0000000c;
    D.S SD:0x10238878 %LE %LONG 0x00033071;
    D.S SD:0x10238a00 %LE %LONG 0x00020083;
    D.S SD:0x102389fc %LE %LONG 0x0000000c;
    D.S SD:0x102389f8 %LE %LONG 0x00033071;
    D.S SD:0x10238b80 %LE %LONG 0x00020000;
    D.S SD:0x10238b7c %LE %LONG 0x00000000;
    D.S SD:0x10238b78 %LE %LONG 0x00001071;
    D.S SD:0x1023819c %LE %LONG 0x00000001;
    D.S SD:0x1023831c %LE %LONG 0x00000001;
    D.S SD:0x102384e4 %LE %LONG 0x00018204;
    D.S SD:0x102384e4 %LE %LONG 0x00018205;
    D.S SD:0x102384e8 %LE %LONG 0x00100004;
    D.S SD:0x102384e4 %LE %LONG 0x00018205;
    D.S SD:0x1023818c %LE %LONG 0x102110c0;
    D.S SD:0x1023830c %LE %LONG 0x102110c0;
    D.S SD:0x102384e8 %LE %LONG 0x00110004;
    D.S SD:0x10238198 %LE %LONG 0x000000f1;
    D.S SD:0x10238318 %LE %LONG 0x000000f1;
    D.S SD:0x1023887c %LE %LONG 0x0000010c;
    D.S SD:0x102389fc %LE %LONG 0x0000010c;
    D.S SD:0x102384e4 %LE %LONG 0x00018225;
    D.S SD:0x1023818c %LE %LONG 0x102190c0;
    D.S SD:0x1023830c %LE %LONG 0x102190c0;
    D.S SD:0x102384e0 %LE %LONG 0xb0100000;
    D.S SD:0x102384e8 %LE %LONG 0x001d0004;
    D.S SD:0x102381a4 %LE %LONG 0x10000000;
    D.S SD:0x10238324 %LE %LONG 0x10000000;
    D.S SD:0x1023818c %LE %LONG 0x102190c0;
    D.S SD:0x1023830c %LE %LONG 0x102190c0;
    D.S SD:0x10238198 %LE %LONG 0x001000f1;
    D.S SD:0x10238318 %LE %LONG 0x001000f1;
    D.S SD:0x102384e0 %LE %LONG 0xbc100001;
    D.S SD:0x102384e4 %LE %LONG 0x00018375;
    D.S SD:0x1023863c %LE %LONG 0xb8000003;
    D.S SD:0x102384e0 %LE %LONG 0xbc120001;
    D.S SD:0x10238640 %LE %LONG 0x81001080;
    D.S SD:0x10230000 %LE %LONG 0x00080100;
    D.S SD:0x10230104 %LE %LONG 0x00000200;
    D.S SD:0x10230108 %LE %LONG 0x12000880;
    D.S SD:0x10230110 %LE %LONG 0x00428010;
    D.S SD:0x10230114 %LE %LONG 0x001a0068;
    D.S SD:0x10230150 %LE %LONG 0x08001800;
    D.S SD:0x10230170 %LE %LONG 0x00000082;
    D.S SD:0x10230178 %LE %LONG 0x00000038;
    D.S SD:0x10230190 %LE %LONG 0x00200001;
    D.S SD:0x102301c8 %LE %LONG 0x00020000;
    D.S SD:0x102301fc %LE %LONG 0xc0421007;
    D.S SD:0x10230204 %LE %LONG 0x80104400;
    D.S SD:0x10230208 %LE %LONG 0x00300700;
    D.S SD:0x10230220 %LE %LONG 0x00000144;
    D.S SD:0x10230238 %LE %LONG 0x01400150;
    D.S SD:0x1023023c %LE %LONG 0x18000005;
    D.S SD:0x1023024c %LE %LONG 0x34082001;
    D.S SD:0x10230250 %LE %LONG 0x81084000;
    D.S SD:0x10230254 %LE %LONG 0x00004f00;
    D.S SD:0x10230260 %LE %LONG 0x01340000;
    D.S SD:0x10230264 %LE %LONG 0x25734000;
    D.S SD:0x10230278 %LE %LONG 0x33355555;
    D.S SD:0x10230284 %LE %LONG 0x00000002;
    D.S SD:0x10230290 %LE %LONG 0x80000000;
    D.S SD:0x10230500 %LE %LONG 0x00080000;
    D.S SD:0x10231604 %LE %LONG 0x00000411;
    D.S SD:0x102316d4 %LE %LONG 0x00000005;
    D.S SD:0x10231dd4 %LE %LONG 0x00000005;
    D.S SD:0x10238640 %LE %LONG 0x8100108c;
    D.S SD:0x10238490 %LE %LONG 0x00000000;
    D.S SD:0x10238190 %LE %LONG 0x00000000;
    D.S SD:0x10238310 %LE %LONG 0x00000000;
    D.S SD:0x10238640 %LE %LONG 0x8100308c;

; lp4_dram_init_vseq() ;
    wait 1.us
    D.S SD:0x102301fc %LE %LONG 0xc0421007;
    D.S SD:0x102301fc %LE %LONG 0xc0423007;
    D.S SD:0x10230204 %LE %LONG 0x80104440;
    D.S SD:0x10230204 %LE %LONG 0x80104450;
		wait 1.us
    D.S SD:0x10230128 %LE %LONG 0x00000d00;
    D.S SD:0x10230124 %LE %LONG 0x00000800;
		wait 1.us
    D.S SD:0x10230124 %LE %LONG 0x00000000;
    D.S SD:0x10230128 %LE %LONG 0x00000156;
    D.S SD:0x10230124 %LE %LONG 0x00000800;
		wait 1.us
    D.S SD:0x10230124 %LE %LONG 0x00000000;
    D.S SD:0x10230128 %LE %LONG 0x00000212;
    D.S SD:0x10230124 %LE %LONG 0x00000800;
		wait 1.us
    D.S SD:0x10230124 %LE %LONG 0x00000000;
    D.S SD:0x10230128 %LE %LONG 0x00000329;
    D.S SD:0x10230124 %LE %LONG 0x00000800;
		wait 1.us
    D.S SD:0x10230124 %LE %LONG 0x00000000;
    D.S SD:0x10230128 %LE %LONG 0x00000d40;
    D.S SD:0x10230124 %LE %LONG 0x00000800;
		wait 1.us
    D.S SD:0x10230124 %LE %LONG 0x00000000;
    D.S SD:0x10230128 %LE %LONG 0x00000156;
    D.S SD:0x10230124 %LE %LONG 0x00000800;
		wait 1.us
    D.S SD:0x10230124 %LE %LONG 0x00000000;
    D.S SD:0x10230128 %LE %LONG 0x00000212;
    D.S SD:0x10230124 %LE %LONG 0x00000800;
		wait 1.us
    D.S SD:0x10230124 %LE %LONG 0x00000000;
    D.S SD:0x10230128 %LE %LONG 0x000003e9;
    D.S SD:0x10230124 %LE %LONG 0x00000800;
		wait 1.us
    D.S SD:0x10230124 %LE %LONG 0x00000000;
    D.S SD:0x10230128 %LE %LONG 0x00000d00;
    D.S SD:0x10230124 %LE %LONG 0x00000800;
		wait 1.us
    D.S SD:0x10230124 %LE %LONG 0x00000000;
    D.S SD:0x10230128 %LE %LONG 0x01000d00;
    D.S SD:0x10230124 %LE %LONG 0x00000800;
		wait 1.us
    D.S SD:0x10230124 %LE %LONG 0x00000000;
    D.S SD:0x10230128 %LE %LONG 0x01000156;
    D.S SD:0x10230124 %LE %LONG 0x00000800;
		wait 1.us
    D.S SD:0x10230124 %LE %LONG 0x00000000;
    D.S SD:0x10230128 %LE %LONG 0x01000212;
    D.S SD:0x10230124 %LE %LONG 0x00000800;
		wait 1.us
    D.S SD:0x10230124 %LE %LONG 0x00000000;
    D.S SD:0x10230128 %LE %LONG 0x01000329;
    D.S SD:0x10230124 %LE %LONG 0x00000800;
		wait 1.us
    D.S SD:0x10230124 %LE %LONG 0x00000000;
    D.S SD:0x10230128 %LE %LONG 0x01000d40;
    D.S SD:0x10230124 %LE %LONG 0x00000800;
		wait 1.us
    D.S SD:0x10230124 %LE %LONG 0x00000000;
    D.S SD:0x10230128 %LE %LONG 0x01000156;
    D.S SD:0x10230124 %LE %LONG 0x00000800;
		wait 1.us
    D.S SD:0x10230124 %LE %LONG 0x00000000;
    D.S SD:0x10230128 %LE %LONG 0x01000212;
    D.S SD:0x10230124 %LE %LONG 0x00000800;
		wait 1.us
    D.S SD:0x10230124 %LE %LONG 0x00000000;
    D.S SD:0x10230128 %LE %LONG 0x010003e9;
    D.S SD:0x10230124 %LE %LONG 0x00000800;
		wait 1.us
    D.S SD:0x10230124 %LE %LONG 0x00000000;
    D.S SD:0x10230128 %LE %LONG 0x01000d00;
    D.S SD:0x10230124 %LE %LONG 0x00000800;
		wait 1.us
    D.S SD:0x10230124 %LE %LONG 0x00000000;
    D.S SD:0x10230204 %LE %LONG 0x80104410;
    D.S SD:0x10230204 %LE %LONG 0x80104400;
    D.S SD:0x102301fc %LE %LONG 0xc0421007;
    D.S SD:0x102301fc %LE %LONG 0xc0420007;
    D.S SD:0x10230264 %LE %LONG 0x05734000;

  ; modify_phypll_mode() ;
    D.S SD:0x100010b4 %LE %LONG 0x00000000;
    D.S SD:0x10238538 %LE %LONG 0x00100000;
    D.S SD:0x10238000 %LE %LONG 0x00000000;
    D.S SD:0x10238538 %LE %LONG 0x00100000;
    D.S SD:0x10248000 %LE %LONG 0x00000000;
    D.S SD:0x100010b4 %LE %LONG 0x0000007f;


  ; sram_init_by_dramc_shu0_0() ;
    D.S SD:0x100010b4 %LE %LONG 0x00000000;
    D.S SD:0x10248618 %LE %LONG 0x20f0501a;
    D.S SD:0x10238618 %LE %LONG 0x20f0501a;
    D.S SD:0x10248618 %LE %LONG 0x20f0500a;
    D.S SD:0x10238618 %LE %LONG 0x20f0500a;
    D.S SD:0x10248618 %LE %LONG 0x20f0500b;
    D.S SD:0x10238618 %LE %LONG 0x20f0500b;
    D.S SD:0x10248618 %LE %LONG 0x20f0500a;
    D.S SD:0x10238618 %LE %LONG 0x20f0500a;
    D.S SD:0x10248618 %LE %LONG 0x20f05008;
    D.S SD:0x10238618 %LE %LONG 0x20f05008;
    D.S SD:0x100010b4 %LE %LONG 0x0000007f;

  ; init_golden_mini_freq_related_vseq_1() ;
    D.S SD:0x10239448 %LE %LONG 0x0e93a4e9;
    D.S SD:0x1023944c %LE %LONG 0x8e93a4e9;
    D.S SD:0x10239450 %LE %LONG 0x14a5294a;
    D.S SD:0x10239454 %LE %LONG 0x14a5294a;
    D.S SD:0x1023945c %LE %LONG 0x00000007;
    D.S SD:0x10239444 %LE %LONG 0x80380004;
    D.S SD:0x100010b4 %LE %LONG 0x00000000;
    D.S SD:0x10239270 %LE %LONG 0x20000000;
    D.S SD:0x10238f70 %LE %LONG 0x20000000;
    D.S SD:0x102390f0 %LE %LONG 0x20000000;
    D.S SD:0x10239274 %LE %LONG 0x00c00604;
    D.S SD:0x10238f74 %LE %LONG 0x00c00604;
    D.S SD:0x102390f4 %LE %LONG 0x00c00604;
    D.S SD:0x102392b8 %LE %LONG 0x00c00010;
    D.S SD:0x10238f7c %LE %LONG 0x0000010c;
    D.S SD:0x10238fb8 %LE %LONG 0x00000010;
    D.S SD:0x102390fc %LE %LONG 0x0000010c;
    D.S SD:0x10239138 %LE %LONG 0x00000010;
    D.S SD:0x10239294 %LE %LONG 0x04707000;
    D.S SD:0x10238f94 %LE %LONG 0x04707000;
    D.S SD:0x10239114 %LE %LONG 0x04707000;
    D.S SD:0x10238e40 %LE %LONG 0x00008380;
    D.S SD:0x10238e44 %LE %LONG 0x00000011;
    D.S SD:0x10238e48 %LE %LONG 0x00000001;
    D.S SD:0x10238e00 %LE %LONG 0xe57800fe;
    D.S SD:0x10238e04 %LE %LONG 0x5b000002;
    D.S SD:0x10238e08 %LE %LONG 0x00040000;
    D.S SD:0x10238e0c %LE %LONG 0x00001263;
    D.S SD:0x10238e20 %LE %LONG 0xe57800fe;
    D.S SD:0x10238e24 %LE %LONG 0x5b000002;
    D.S SD:0x10238e28 %LE %LONG 0x00040000;
    D.S SD:0x1023926c %LE %LONG 0x00000000;
    D.S SD:0x1023928c %LE %LONG 0x1ee9910a;
    D.S SD:0x10239498 %LE %LONG 0x00000002;
    D.S SD:0x1023943c %LE %LONG 0x00000023;
    D.S SD:0x10238f8c %LE %LONG 0xa22a56d9;
    D.S SD:0x1023910c %LE %LONG 0x26d7dcce;
    D.S SD:0x10239284 %LE %LONG 0x000a0000;
    D.S SD:0x10239298 %LE %LONG 0x00017d1c;
    D.S SD:0x1023929c %LE %LONG 0x4893042f;
    D.S SD:0x10238f98 %LE %LONG 0x00017d1c;
    D.S SD:0x10239118 %LE %LONG 0x00017d1c;
    D.S SD:0x10238f9c %LE %LONG 0x014de708;
    D.S SD:0x1023911c %LE %LONG 0xab1d8b01;
    D.S SD:0x10239280 %LE %LONG 0x00020000;
    D.S SD:0x10238f80 %LE %LONG 0x00020003;
    D.S SD:0x10239100 %LE %LONG 0x00020003;
    D.S SD:0x10239278 %LE %LONG 0x00001071;
    D.S SD:0x10238f78 %LE %LONG 0x00033071;
    D.S SD:0x102390f8 %LE %LONG 0x00033071;
    D.S SD:0x10249270 %LE %LONG 0x20000000;
    D.S SD:0x10248f70 %LE %LONG 0x20000000;
    D.S SD:0x102490f0 %LE %LONG 0x20000000;
    D.S SD:0x10249274 %LE %LONG 0x00c00604;
    D.S SD:0x10248f74 %LE %LONG 0x00c00604;
    D.S SD:0x102490f4 %LE %LONG 0x00c00604;
    D.S SD:0x102492b8 %LE %LONG 0x00c00010;
    D.S SD:0x10248f7c %LE %LONG 0x0000010c;
    D.S SD:0x10248fb8 %LE %LONG 0x00000010;
    D.S SD:0x102490fc %LE %LONG 0x0000010c;
    D.S SD:0x10249138 %LE %LONG 0x00000010;
    D.S SD:0x10249294 %LE %LONG 0x04707000;
    D.S SD:0x10248f94 %LE %LONG 0x04707000;
    D.S SD:0x10249114 %LE %LONG 0x04707000;
    D.S SD:0x10248e40 %LE %LONG 0x000049a6;
    D.S SD:0x10248e44 %LE %LONG 0x00000011;
    D.S SD:0x10248e48 %LE %LONG 0x00000001;
    D.S SD:0x10248e00 %LE %LONG 0xe57800fe;
    D.S SD:0x10248e04 %LE %LONG 0x5b000002;
    D.S SD:0x10248e08 %LE %LONG 0x00040000;
    D.S SD:0x10248e0c %LE %LONG 0x00001263;
    D.S SD:0x10248e20 %LE %LONG 0xe57800fe;
    D.S SD:0x10248e24 %LE %LONG 0x5b000002;
    D.S SD:0x10248e28 %LE %LONG 0x00040000;
    D.S SD:0x1024926c %LE %LONG 0x00000000;
    D.S SD:0x1024928c %LE %LONG 0x9c99e890;
    D.S SD:0x10249498 %LE %LONG 0x00000002;
    D.S SD:0x1024943c %LE %LONG 0x00000023;
    D.S SD:0x10248f8c %LE %LONG 0xa1eae981;
    D.S SD:0x1024910c %LE %LONG 0x65ef6a61;
    D.S SD:0x10249284 %LE %LONG 0x000a0000;
    D.S SD:0x10249298 %LE %LONG 0x00017d1c;
    D.S SD:0x1024929c %LE %LONG 0x078e650e;
    D.S SD:0x10248f98 %LE %LONG 0x00017d1c;
    D.S SD:0x10249118 %LE %LONG 0x00017d1c;
    D.S SD:0x10248f9c %LE %LONG 0x9316f9ad;
    D.S SD:0x1024911c %LE %LONG 0x11f76cd0;
    D.S SD:0x10249280 %LE %LONG 0x00020000;
    D.S SD:0x10248f80 %LE %LONG 0x00020003;
    D.S SD:0x10249100 %LE %LONG 0x00020003;
    D.S SD:0x10249278 %LE %LONG 0x00001071;
    D.S SD:0x10248f78 %LE %LONG 0x00033071;
    D.S SD:0x102490f8 %LE %LONG 0x00033071;
    D.S SD:0x100010b4 %LE %LONG 0x0000007f;
    D.S SD:0x102392a8 %LE %LONG 0x000ba000;
    D.S SD:0x10238fa8 %LE %LONG 0x000ae800;
    D.S SD:0x10239128 %LE %LONG 0x000ae800;
    D.S SD:0x10238fb4 %LE %LONG 0x00000004;
    D.S SD:0x10239134 %LE %LONG 0x00000004;
    D.S SD:0x1023947c %LE %LONG 0x010ff04f;
    D.S SD:0x10239438 %LE %LONG 0x000e0e0f;
    D.S SD:0x10239424 %LE %LONG 0x01118500;
    D.S SD:0x10239420 %LE %LONG 0x64460013;
    D.S SD:0x1023948c %LE %LONG 0x00000444;
    D.S SD:0x102392e0 %LE %LONG 0x00000006;
    D.S SD:0x10239360 %LE %LONG 0x00000006;
    D.S SD:0x10238ea0 %LE %LONG 0x000000c8; ;hj 1st,a8 -> c8;2nd c8
    D.S SD:0x10238ea4 %LE %LONG 0x00000019;
    D.S SD:0x10238f20 %LE %LONG 0x000000c8; ;hj 1st,a8 -> c8;2nd c8
    D.S SD:0x10238f24 %LE %LONG 0x00000019;
    D.S SD:0x10239020 %LE %LONG 0x000000c8; ;hj 1st,a8 -> c8;2nd c8
    D.S SD:0x10239024 %LE %LONG 0x00000019;
    D.S SD:0x102390a0 %LE %LONG 0x000000c8; ;hj 1st,a8 -> c8;2nd c8
    D.S SD:0x102390a4 %LE %LONG 0x00000019;
    D.S SD:0x10239428 %LE %LONG 0xe0000041;
    D.S SD:0x10238f84 %LE %LONG 0x35008000;
    D.S SD:0x10239104 %LE %LONG 0x35008000;
    D.S SD:0x10238ea8 %LE %LONG 0x00000033;
    D.S SD:0x10238f28 %LE %LONG 0x00000033;
    D.S SD:0x10239028 %LE %LONG 0x00000033;
    D.S SD:0x102390a8 %LE %LONG 0x00000033;
    D.S SD:0x10231d8c %LE %LONG 0x0000003c;
    D.S SD:0x10239478 %LE %LONG 0x02000791;
    D.S SD:0x102392e8 %LE %LONG 0x0000bfe0;
    D.S SD:0x10239368 %LE %LONG 0x0000bfe0;
    D.S SD:0x10238e98 %LE %LONG 0x00000819;
    D.S SD:0x10239018 %LE %LONG 0x00000819;
    D.S SD:0x10238f18 %LE %LONG 0x00000819;
    D.S SD:0x10239098 %LE %LONG 0x00000819;
    D.S SD:0x10238e9c %LE %LONG 0x0a000819;
    D.S SD:0x1023901c %LE %LONG 0x0a000819;
    D.S SD:0x10238f1c %LE %LONG 0x0a000819;
    D.S SD:0x1023909c %LE %LONG 0x0a000819;
    D.S SD:0x10238e94 %LE %LONG 0x001b1b00;
    D.S SD:0x10239014 %LE %LONG 0x00181800;
    D.S SD:0x10238f14 %LE %LONG 0x001a1a00;
    D.S SD:0x10239094 %LE %LONG 0x00191900;
    D.S SD:0x10231d10 %LE %LONG 0x80006080;
    D.S SD:0x10231dac %LE %LONG 0x8000020a;
    D.S SD:0x10231930 %LE %LONG 0x00000030;
    D.S SD:0x10231b30 %LE %LONG 0x00000030;
    D.S SD:0x10231da8 %LE %LONG 0x02020000;
    D.S SD:0x10231d7c %LE %LONG 0x11331144;
    D.S SD:0x10231900 %LE %LONG 0x11331144;
    D.S SD:0x10231904 %LE %LONG 0x11331144;
    D.S SD:0x10231908 %LE %LONG 0x11221111;
    D.S SD:0x1023190c %LE %LONG 0x11221111;
    D.S SD:0x10231b00 %LE %LONG 0x11331144;
    D.S SD:0x10231b04 %LE %LONG 0x11331144;
    D.S SD:0x10231b08 %LE %LONG 0x11221111;
    D.S SD:0x10231b0c %LE %LONG 0x11221111;
    D.S SD:0x10231910 %LE %LONG 0x0018001b;
    D.S SD:0x10231914 %LE %LONG 0x0018001b;
    D.S SD:0x10231920 %LE %LONG 0x0018001b;
    D.S SD:0x10231b10 %LE %LONG 0x0019001a;
    D.S SD:0x10231b14 %LE %LONG 0x0019001a;
    D.S SD:0x10231b20 %LE %LONG 0x0019001a;
    D.S SD:0x10231924 %LE %LONG 0x1b181b18;
    D.S SD:0x10231b24 %LE %LONG 0x1a191a19;
    D.S SD:0x10238e60 %LE %LONG 0x04040404;
    D.S SD:0x10238e64 %LE %LONG 0x04040404;
    D.S SD:0x10238e6c %LE %LONG 0x00000004;
    D.S SD:0x10238fe0 %LE %LONG 0x2c2c2c2c;
    D.S SD:0x10238fe4 %LE %LONG 0x2c2c2c2c;
    D.S SD:0x10238fec %LE %LONG 0x0000002c;
    D.S SD:0x10238ee0 %LE %LONG 0x10101010;
    D.S SD:0x10238ee4 %LE %LONG 0x10101010;
    D.S SD:0x10238eec %LE %LONG 0x00000010;
    D.S SD:0x10239060 %LE %LONG 0x1c1c1c1c;
    D.S SD:0x10239064 %LE %LONG 0x1c1c1c1c;
    D.S SD:0x1023906c %LE %LONG 0x0000001c;
    D.S SD:0x10231d98 %LE %LONG 0x00000011;
    D.S SD:0x10238f8c %LE %LONG 0xa22856d9;
    D.S SD:0x1023910c %LE %LONG 0x26d1dcce;
    D.S SD:0x10231d18 %LE %LONG 0x00000000;
    D.S SD:0x10231d1c %LE %LONG 0x00010000;
    D.S SD:0x10231d20 %LE %LONG 0x00000000;
    D.S SD:0x10231d24 %LE %LONG 0x00000000;
    D.S SD:0x10231d28 %LE %LONG 0x11111011;
    D.S SD:0x10231d08 %LE %LONG 0x30000030;
    D.S SD:0x10231d14 %LE %LONG 0x00004b00;
    D.S SD:0x10231d60 %LE %LONG 0x08080a06;
    D.S SD:0x10231d44 %LE %LONG 0x66030e4a;
    D.S SD:0x10231d48 %LE %LONG 0x0a050475;
    D.S SD:0x10231d4c %LE %LONG 0x030a3081;
    D.S SD:0x10231d50 %LE %LONG 0x0049881f;
    D.S SD:0x10231d54 %LE %LONG 0x190c3c57;
    D.S SD:0x10231d58 %LE %LONG 0x001c1110;
    D.S SD:0x10231d5c %LE %LONG 0x48d05509;
    D.S SD:0x10231d78 %LE %LONG 0x03223000;
    D.S SD:0x10231da4 %LE %LONG 0x00070002;
    D.S SD:0x10239470 %LE %LONG 0x00000002;
    D.S SD:0x10238f88 %LE %LONG 0x0020004a;
    D.S SD:0x10239108 %LE %LONG 0x0020004a;
    D.S SD:0x10238f6c %LE %LONG 0x0060000e;
    D.S SD:0x102390ec %LE %LONG 0x0060000e;
    D.S SD:0x10238e74 %LE %LONG 0xb6b6b6b6;
    D.S SD:0x10238e78 %LE %LONG 0xb6b6b6b6;
    D.S SD:0x10238e7c %LE %LONG 0xb6b6b6b6;
    D.S SD:0x10238e80 %LE %LONG 0xb6b6b6b6;
    D.S SD:0x10238e84 %LE %LONG 0x0000b6b6;
    D.S SD:0x10238e88 %LE %LONG 0x01470147;
    D.S SD:0x10238ef4 %LE %LONG 0xb5b5b5b5;
    D.S SD:0x10238ef8 %LE %LONG 0xb5b5b5b5;
    D.S SD:0x10238efc %LE %LONG 0xb5b5b5b5;
    D.S SD:0x10238f00 %LE %LONG 0xb5b5b5b5;
    D.S SD:0x10238f04 %LE %LONG 0x0000b5b5;
    D.S SD:0x10238f08 %LE %LONG 0x01460146;
    D.S SD:0x10238ff4 %LE %LONG 0xb6b6b6b6;
    D.S SD:0x10238ff8 %LE %LONG 0xb6b6b6b6;
    D.S SD:0x10238ffc %LE %LONG 0xb6b6b6b6;
    D.S SD:0x10239000 %LE %LONG 0xb6b6b6b6;
    D.S SD:0x10239004 %LE %LONG 0x0000b6b6;
    D.S SD:0x10239008 %LE %LONG 0x01470147;
    D.S SD:0x10239074 %LE %LONG 0xb5b5b5b5;
    D.S SD:0x10239078 %LE %LONG 0xb5b5b5b5;
    D.S SD:0x1023907c %LE %LONG 0xb5b5b5b5;
    D.S SD:0x10239080 %LE %LONG 0xb5b5b5b5;
    D.S SD:0x10239084 %LE %LONG 0x0000b5b5;
    D.S SD:0x10239088 %LE %LONG 0x01460146;
    D.S SD:0x10231d04 %LE %LONG 0x00001402;
    D.S SD:0x10231d74 %LE %LONG 0x80000026;
    D.S SD:0x10231d10 %LE %LONG 0xa0006080;
    D.S SD:0x10231da0 %LE %LONG 0x000811bf;
    D.S SD:0x10231d00 %LE %LONG 0x00000012;
    D.S SD:0x10231d88 %LE %LONG 0x0e13220d;
    D.S SD:0x10239418 %LE %LONG 0x00009800;
    D.S SD:0x10239414 %LE %LONG 0x00004310;
    D.S SD:0x102392e4 %LE %LONG 0x00000010;
    D.S SD:0x10239364 %LE %LONG 0x00000010;
    D.S SD:0x1023942c %LE %LONG 0x00082119;
    D.S SD:0x10239488 %LE %LONG 0x00000002;
    D.S SD:0x10231d3c %LE %LONG 0x0008000d;
    D.S SD:0x10231d40 %LE %LONG 0x0000000d;
    D.S SD:0x10231db0 %LE %LONG 0x20200000;
    D.S SD:0x1023941c %LE %LONG 0x005a05a1;
    D.S SD:0x100010b4 %LE %LONG 0x00000000;
    D.S SD:0x100010b4 %LE %LONG 0x0000007f;
    D.S SD:0x10231d94 %LE %LONG 0xffff000c;
    D.S SD:0x10231d90 %LE %LONG 0x00040211;
    D.S SD:0x10231928 %LE %LONG 0x0b060b06;
    D.S SD:0x10231b28 %LE %LONG 0x0b060b06;
    D.S SD:0x1023192c %LE %LONG 0x00c50128;
    D.S SD:0x10231b2c %LE %LONG 0x00c50128;
    D.S SD:0x10231d88 %LE %LONG 0x0613220d;
    D.S SD:0x10231d90 %LE %LONG 0x00040210;
    D.S SD:0x10231d9c %LE %LONG 0xe0000000;
    D.S SD:0x10231d9c %LE %LONG 0xe0000005;
    D.S SD:0x10231d14 %LE %LONG 0x00054b00;
    D.S SD:0x10238f88 %LE %LONG 0x0020804a;
    D.S SD:0x10239108 %LE %LONG 0x0020804a;
    D.S SD:0x10238f84 %LE %LONG 0x35008e00;
    D.S SD:0x10239104 %LE %LONG 0x35008e00;
    D.S SD:0x10238f80 %LE %LONG 0x00020083;
    D.S SD:0x10239100 %LE %LONG 0x00020083;


  ; sram_init_by_dramc_shu0_1() ;
    D.S SD:0x100010b4 %LE %LONG 0x00000000;
    D.S SD:0x10248618 %LE %LONG 0x20f0500a;
    D.S SD:0x10238618 %LE %LONG 0x20f0500a;
    D.S SD:0x10248618 %LE %LONG 0x20f0511a;
    D.S SD:0x10238618 %LE %LONG 0x20f0511a;
    D.S SD:0x10248618 %LE %LONG 0x20f0511b;
    D.S SD:0x10238618 %LE %LONG 0x20f0511b;
    D.S SD:0x10248618 %LE %LONG 0x20f0511a;
    D.S SD:0x10238618 %LE %LONG 0x20f0511a;
    D.S SD:0x10248618 %LE %LONG 0x20f05118;
    D.S SD:0x10238618 %LE %LONG 0x20f05118;
    D.S SD:0x100010b4 %LE %LONG 0x0000007f;

  ; freq_group_mapping_init_vseq() ;
    D.S SD:0x100010b4 %LE %LONG 0x00000000;
    D.S SD:0x10238514 %LE %LONG 0x0000d300;
    D.S SD:0x10230210 %LE %LONG 0x00010001;
    D.S SD:0x10248514 %LE %LONG 0x0000c300;
    D.S SD:0x10240210 %LE %LONG 0x00010001;
    D.S SD:0x100010b4 %LE %LONG 0x0000007f;
    D.S SD:0x100010b4 %LE %LONG 0x00000000;
    D.S SD:0x1024865c %LE %LONG 0xfffbfbfb;
    D.S SD:0x1023865c %LE %LONG 0xfff7fbfb;
    D.S SD:0x100010b4 %LE %LONG 0x0000007f;
    D.S SD:0x1023851c %LE %LONG 0x00051003;
    D.S SD:0x100010b4 %LE %LONG 0x00000000;
    D.S SD:0x1024851c %LE %LONG 0x000d1003;
    D.S SD:0x100010b4 %LE %LONG 0x0000007f;
    D.S SD:0x100010b4 %LE %LONG 0x00000000;
    D.S SD:0x10230208 %LE %LONG 0x00300701;
    D.S SD:0x10240208 %LE %LONG 0x00300702;
    D.S SD:0x100010b4 %LE %LONG 0x0000007f;
    D.S SD:0x10238518 %LE %LONG 0x0fc0a710;
    D.S SD:0x10238520 %LE %LONG 0x00000003;
    D.S SD:0x10230224 %LE %LONG 0x00010000;
    D.S SD:0x10238618 %LE %LONG 0x00f05118;

  ; indiv_rand_reg_settings_vseq() ;
    D.S SD:0x10230248 %LE %LONG 0x098e0080;
    D.S SD:0x10230228 %LE %LONG 0x00000004;
    D.S SD:0x10231604 %LE %LONG 0x00001411;
    D.S SD:0x1023012c %LE %LONG 0x00000001;
    D.S SD:0x10230254 %LE %LONG 0x00004f00;
    D.S SD:0x1023017c %LE %LONG 0x00000161;
    D.S SD:0x10230108 %LE %LONG 0x12000880;
    D.S SD:0x10230170 %LE %LONG 0x00000086;
    D.S SD:0x10230238 %LE %LONG 0x01400150;
    D.S SD:0x1023024c %LE %LONG 0x34082009;
    D.S SD:0x10230190 %LE %LONG 0x00200001;
    D.S SD:0x1023024c %LE %LONG 0x34082008;
    D.S SD:0x10230174 %LE %LONG 0x00000000;
    D.S SD:0x10230284 %LE %LONG 0x00000003;
    D.S SD:0x10230220 %LE %LONG 0x00000144;
    D.S SD:0x10230178 %LE %LONG 0x00000039;
    D.S SD:0x10230234 %LE %LONG 0x00000000;
    D.S SD:0x10230174 %LE %LONG 0x0000000f;
    D.S SD:0x10230168 %LE %LONG 0x00588780;
    D.S SD:0x10230204 %LE %LONG 0x80504400;
    D.S SD:0x10230240 %LE %LONG 0x4000001e;
    D.S SD:0x10230268 %LE %LONG 0x3200016d;
    D.S SD:0x1023028c %LE %LONG 0x0000041f;
    D.S SD:0x10230264 %LE %LONG 0x05734009;
    D.S SD:0x1023864c %LE %LONG 0x0000003f;
    D.S SD:0x10238648 %LE %LONG 0x11001135;
    D.S SD:0x10238634 %LE %LONG 0x00000001;
    D.S SD:0x10238638 %LE %LONG 0x00000001;
    D.S SD:0x10238618 %LE %LONG 0x00f05118;
    D.S SD:0x10230250 %LE %LONG 0x81084000;
    D.S SD:0x1023851c %LE %LONG 0x00051003;
    D.S SD:0x10238538 %LE %LONG 0x00100000;
    D.S SD:0x10238618 %LE %LONG 0x00f05118;
    D.S SD:0x1023861c %LE %LONG 0x17000330;
    D.S SD:0x10238504 %LE %LONG 0x00010000;
    D.S SD:0x10238510 %LE %LONG 0x38043333;
    D.S SD:0x10238b90 %LE %LONG 0x0f0f0f01;
    D.S SD:0x10239290 %LE %LONG 0x0f0f0f01;
    D.S SD:0x102384e8 %LE %LONG 0x401d0004;
    D.S SD:0x10238514 %LE %LONG 0x0000d300;
    D.S SD:0x10248514 %LE %LONG 0x0000c300;
    D.S SD:0x10238514 %LE %LONG 0x0000d300;
    D.S SD:0x10248514 %LE %LONG 0x0000c300;
    D.S SD:0x10230208 %LE %LONG 0x00300701;
    D.S SD:0x10240208 %LE %LONG 0x00300702;
    D.S SD:0x10230208 %LE %LONG 0x00300701;
    D.S SD:0x10240208 %LE %LONG 0x00300702;
    D.S SD:0x10230208 %LE %LONG 0x00300701;
    D.S SD:0x10240208 %LE %LONG 0x00300702;


    ; DRAMC TEST AGENT
    ;Configuration :
    ;0x108 [3   :0] TESTCNT         = 4¡¦h1 (0 for rank 0 only)
    ;0x10c [16    ] TESTXTALKPAT    = 1¡¦h1 (pattern)
    ;0x10c [30 :28] TESTAGENTRKSEL  = 3¡¦h4
    ;0x104 [31 : 4] TEST2_OFF       = 28¡¦h20( test2 length )
    D.S SD:0x10230108 %LE %LONG 0x12000881;
    D.S SD:0x1023010c %LE %LONG 0x40010000;

    ; Trigger
    ;0x108 [31] TEST2W (read after write)
    D.S SD:0x10230108 %LE %LONG 0x92000881;

    ;Result(dranc_nao) : 0x10234000
    ;0x120[5] DM_CMP_ERR_RK1
    ;0x120[4] DM_CMP_ERR_RK0
    ;0x120[1] DM_CMP_CPT_RK1
    ;0x120[0] DM_CMP_CPT_RK0

;DRAMC brocast on
D.S SD:0x100010B4 %LE %LONG 0x0000007f;
;EMI setting 2
D.S SD:0x10219060 %LE %LONG 0x00005400;
D.S SD:0x10235010 %LE %LONG 0x04000005;
;DRAMC brocast off
D.S SD:0x100010B4 %LE %LONG 0x00000000;

